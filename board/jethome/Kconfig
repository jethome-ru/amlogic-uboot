## board/jethome/Kconfig
```kconfig
config JETHUB_D1_V1
	bool "Support JetHome D1 (J100) v1 board"
	default n

config JETHUB_J200_V1
	bool "Support JetHome D2/H2 (J200) v1 board"
	default n

config JETHUB_H1_V1
	bool "Support JetHome H1 (J80) v1 board"
	default n

if JETHUB_D1_V1
source "board/jethome/jethub_d1_v1/Kconfig"
endif

if JETHUB_J200_V1
source "board/jethome/jethub_j200_v1/Kconfig"
endif

if JETHUB_H1_V1
source "board/jethome/jethub_h1_v1/Kconfig"
endif
```

## board/jethome/defconfigs/jethub_d1_v1_defconfig
```kconfig
CONFIG_ARM=y
CONFIG_TARGET_MESON_AXG=y
CONFIG_JETHUB_D1_V1=y
CONFIG_DM=y
CONFIG_DM_GPIO=y
CONFIG_AML_GPIO=y
CONFIG_LOCALVERSION="-jethome"
```

## board/jethome/defconfigs/jethub_h1_v1_defconfig
```kconfig
CONFIG_ARM=y
CONFIG_TARGET_MESON_GX=y
CONFIG_JETHUB_H1_V1=y
CONFIG_DM=y
CONFIG_DM_GPIO=y
CONFIG_AML_GPIO=y
CONFIG_LOCALVERSION="-jethome"
CONFIG_AML_RPMB_DISABLE=y
```

## board/jethome/defconfigs/jethub_j200_v1_defconfig
```kconfig
CONFIG_ARM=y
CONFIG_TARGET_MESON_G12A=y
CONFIG_DM=y
CONFIG_DM_GPIO=y
CONFIG_AML_GPIO=y
CONFIG_OF_LIBFDT_OVERLAY=y
CONFIG_LOCALVERSION="-jethome"
CONFIG_AML_RPMB_DISABLE=y
CONFIG_JETHUB_J200_V1=y
```

## board/jethome/jethub-d2_v1/Kconfig
```kconfig
if JETHUB_D2_V1

config SYS_CPU
	string
	default "armv8"

config SYS_BOARD
	string
	default "jethub-d2_v1"

config SYS_VENDOR
	string
	default "jethome"

config SYS_SOC
	string
	default "g12a"

config SYS_CONFIG_NAME
	default "jethub-d2_v1"

endif
```

## board/jethome/jethub_d1_v1/Kconfig
```kconfig
if JETHUB_D1_V1

config SYS_CPU
	string
	default "armv8"

config SYS_BOARD
	string
	default "jethub_d1_v1"

config SYS_VENDOR
	string
	default "jethome"

config SYS_SOC
	string
	default "axg"

config SYS_CONFIG_NAME
	default "jethub_d1_v1"

endif
```

## board/jethome/jethub_h1_v1/Kconfig
```kconfig
if JETHUB_H1_V1

config SYS_CPU
	string
	default "armv8"

config SYS_BOARD
	string
	default "jethub_h1_v1"

config SYS_VENDOR
	string
	default "jethome"

config SYS_SOC
	string
	default "gxl"

config SYS_CONFIG_NAME
	default "jethub_h1_v1"

endif
```

## board/jethome/jethub_j200_v1/Kconfig
```kconfig
if JETHUB_J200_V1

config SYS_CPU
	string
	default "armv8"

config SYS_BOARD
	string
	default "jethub_j200_v1"

config SYS_VENDOR
	string
	default "jethome"

config SYS_SOC
	string
	default "g12a"

config SYS_CONFIG_NAME
	default "jethub_j200_v1"

endif
```
